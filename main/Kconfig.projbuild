## main/Kconfig.projbuild
```kconfig
menu "esp32-nuts"

    config ESPNUTS_HOSTNAME
        string "mDNS hostname"
        default "esp32-nuts"
        help
            The device announces itself as <hostname>.local.

    config ESPNUTS_WIFI_SSID
        string "Default WiFi SSID (optional)"
        default ""
        help
            Baked-in WiFi credentials for local builds. If empty and nothing
            is stored in NVS, the device starts a provisioning access point
            named "esp32-nuts-setup" instead.

    config ESPNUTS_WIFI_PASSWORD
        string "Default WiFi password (optional)"
        default ""

    config ESPNUTS_NUT_PORT
        int "NUT server TCP port"
        default 3493

    config ESPNUTS_OTA_URL
        string "HTTPS OTA firmware URL (empty to disable)"
        default ""
        help
            When set, the device checks this URL once after boot for a newer
            esp32-nuts-usb-*.bin (merged image). Example: a GitHub release asset.

endmenu
```

## sdkconfig.defaults
```kconfig
# esp32-nuts — common build defaults (ESP32-S2FN4R2: 4MB flash, 2MB in-package PSRAM)
CONFIG_IDF_TARGET="esp32s2"

CONFIG_ESPTOOLPY_FLASHSIZE_4MB=y
CONFIG_PARTITION_TABLE_CUSTOM=y
CONFIG_PARTITION_TABLE_CUSTOM_FILENAME="partitions.csv"

# In-package PSRAM (the R2 in S2FN4R2)
CONFIG_SPIRAM=y
CONFIG_SPIRAM_IGNORE_NOTFOUND=y

CONFIG_FREERTOS_HZ=1000

# Roomier HTTP request headers (some browsers send a lot)
CONFIG_HTTPD_MAX_REQ_HDR_LEN=1024
CONFIG_HTTPD_MAX_URI_LEN=512
```
